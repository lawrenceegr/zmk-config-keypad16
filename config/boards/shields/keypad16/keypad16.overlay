/ {
    chosen {
        zmk,kscan = &default_kscan;
    };

    default_kscan: kscan {
        compatible = "zmk,kscan-gpio-direct";
        label = "default_kscan";
        input-gpios = <&gpio0 4 (GPIO_ACTIVE_HIGH | GPIO_PULL_DOWN)>, 
                      <&gpio0 5 (GPIO_ACTIVE_HIGH | GPIO_PULL_DOWN)>; 
    };
};
